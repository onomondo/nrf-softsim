## sysbuild/Kconfig
```kconfig
menu "Onomondo SoftSIM Options"

config SOFTSIM_BUNDLE_TEMPLATE_HEX
    bool "Automatically bundle the template profile hex into the application"
    default n

endmenu
```

## west.yml
```yaml
manifest:
  remotes:
    - name: nrfconnect
      url-base: https://github.com/nrfconnect/
  projects:
    - name: sdk-nrf
      path: nrf
      revision: v3.4.0
      remote: nrfconnect
      import: true
      submodules: true
  self:
    path: modules/lib/onomondo-softsim
```
