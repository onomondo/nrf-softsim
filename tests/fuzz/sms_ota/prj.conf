## CMakeLists.txt
```
# SPDX-FileCopyrightText: Copyright (c) 2026 Onomondo ApS
# SPDX-License-Identifier: GPL-3.0-only

cmake_minimum_required(VERSION 3.20.0)
find_package(Zephyr REQUIRED HINTS $ENV{ZEPHYR_BASE})
project(softsim_fuzz_sms_ota)

include(${CMAKE_CURRENT_LIST_DIR}/../common/softsim_fuzz.cmake)

# port heap: same as transact -- the nRF filesystem port is in the build, and
# ss_uicc_sms_rx -> ss_uicc_remote_cmd_receive reads keys/counters from storage.
softsim_fuzz_core(HEAP port)

target_sources(app PRIVATE
  ${SOFTSIM_FUZZ_COMMON}/fuzz_entry.c
  src/main.c
  ${SOFTSIM_LIB}/ss_fs.c
  ${SOFTSIM_LIB}/ss_cache.c
  ${SOFTSIM_LIB}/ss_heap.c
)

target_link_libraries(app PRIVATE uicc storage milenage crypto)

target_compile_definitions(app PRIVATE
  CONFIG_SOFTSIM_NRF_LOG_LEVEL=3
  CONFIG_COMPACT_STORAGE=1
)

generate_inc_file_for_target(app ${SOFTSIM_LIB}/profile/template.bin
  ${ZEPHYR_BINARY_DIR}/include/generated/template_bin.inc)

set_source_files_properties(${SOFTSIM_LIB}/ss_fs.c
  DIRECTORY ${CMAKE_CURRENT_LIST_DIR}
  PROPERTIES COMPILE_OPTIONS "-Wno-error;-DFLASH_AREA_SIZE(label)=PARTITION_SIZE(label)")
```

## prj.conf
```kconfig
# SPDX-FileCopyrightText: Copyright (c) 2026 Onomondo ApS
# SPDX-License-Identifier: GPL-3.0-only

CONFIG_ARCH_POSIX_LIBFUZZER=y
CONFIG_ASSERT=y

CONFIG_FLASH=y
CONFIG_FLASH_MAP=y
CONFIG_FLASH_SIMULATOR=y
CONFIG_NVS=y

CONFIG_HEAP_MEM_POOL_SIZE=65536
```

## boards/native_sim.overlay
```dts
/*
 * SPDX-FileCopyrightText: Copyright (c) 2026 Onomondo ApS
 * SPDX-License-Identifier: GPL-3.0-only
 *
 * Same nvs_storage partition as tests/apdu/boards/native_sim.overlay; ss_fs.c
 * needs it to resolve PARTITION_*(nvs_storage) on native_sim's flash0.
 */

&flash0 {
	partitions {
		nvs_storage: partition@100000 {
			label = "nvs_storage";
			reg = <0x00100000 0x00008000>;
		};
	};
};
```

## src/main.c
```c
/*
 * SPDX-FileCopyrightText: Copyright (c) 2026 Onomondo ApS
 * SPDX-License-Identifier: GPL-3.0-only
 *
 * SMS-PP / OTA fuzz target: each case is an SMS TPDU handed to ss_uicc_sms_rx()
 * -- the boundary an SMS-PP DOWNLOAD arrives at inside an ENVELOPE. It decodes
 * the TP header, reassembles concatenated messages, and (on a CPI command)
 * dispatches into ss_uicc_remote_cmd_receive(), so this reaches the SMS parser,
 * the concatenation state machine and the OTA command framing in one target,
 * without the fuzzer having to rediscover the ENVELOPE wrapping each time.
 *
 * It runs over the same provisioned filesystem as the transact target, because
 * ss_uicc_sms_rx uses the real context (ctx->fs_chg_filelist) and the OTA path
 * reads keys/counters from storage.
 */

#include <stdint.h>
#include <string.h>

#include <zephyr/drivers/flash.h>
#include <zephyr/kernel.h>
#include <zephyr/logging/log.h>
#include <zephyr/storage/flash_map.h>

#include <nrf_softsim.h>
#include <onomondo/softsim/softsim.h>
#include <onomondo/softsim/utils.h>

#include "uicc_sms_rx.h"
#include "fuzz_entry.h"

LOG_MODULE_REGISTER(softsim, CONFIG_SOFTSIM_NRF_LOG_LEVEL);

static const uint8_t template_bin[] = {
#include <template_bin.inc>
};

#define RSP_MAX 260
/* An SMS-PP TPDU arrives inside an ENVELOPE, whose command body is capped at
 * apdu.cmd[256]; nothing longer can reach this path on a device. */
#define TPDU_MAX 256

static struct ss_context *ctx;

void fuzz_setup(void)
{
	const struct device *flash_dev = PARTITION_DEVICE(nvs_storage);

	__ASSERT(device_is_ready(flash_dev), "flash simulator not ready");
	flash_erase(flash_dev, PARTITION_OFFSET(nvs_storage), PARTITION_SIZE(nvs_storage));
	flash_write(flash_dev, PARTITION_OFFSET(nvs_storage), template_bin, sizeof(template_bin));

	__ASSERT(ss_init_fs() == 0, "ss_init_fs() rejected the template image");

	ctx = ss_new_ctx();
	__ASSERT(ctx != NULL, "could not allocate a UICC context");
}

void fuzz_one(const uint8_t *data, size_t len)
{
	uint8_t rsp[RSP_MAX];
	size_t rsp_len = sizeof(rsp);
	struct ss_buf *tpdu;

	if (len == 0 || len > TPDU_MAX)
		return;

	/* ponytail: ss_reset gives each case the same selection start, but the SMS
	 * concatenation state (ctx->proactive.sms_rx_state) and any flash writes
	 * persist across cases within the one booted OS -- reachability grows over
	 * a run, reproduction of a mid-run crash may need the corpus order. Same
	 * ceiling and upgrade path as the transact target.
	 *
	 * ponytail: the template image provisions no TAR key/counter files
	 * (0xA004/0xA005), so ss_uicc_remote_cmd_receive returns at its first
	 * ss_fs_select(TAR_KEY_FID) -- the SMS decode, reassembly and command
	 * framing are fuzzed, the OTA crypto/counter path past that select is not.
	 * Upgrade path: write those two files into NVS in fuzz_setup() (see the TAR
	 * handling in uicc_remote_cmd.c) to unlock the deeper OTA logic. */
	ss_reset(ctx);

	/* ss_uicc_sms_rx only reads the buffer; the caller owns it. */
	tpdu = ss_buf_alloc_and_cpy(data, len);
	ss_uicc_sms_rx(ctx, tpdu, &rsp_len, rsp);
	ss_buf_free(tpdu);
}
```
