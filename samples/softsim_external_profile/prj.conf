## CMakeLists.txt
```
# SPDX-FileCopyrightText: Copyright (c) 2023-2024 Onomondo ApS
# SPDX-License-Identifier: GPL-3.0-only

cmake_minimum_required(VERSION 3.20.0)

list(APPEND OVERLAY_CONFIG "$ENV{ZEPHYR_BASE}/../modules/lib/onomondo-softsim/overlay-softsim.conf")

find_package(Zephyr REQUIRED HINTS $ENV{ZEPHYR_BASE})
project(softsim)

target_sources(app PRIVATE src/main.c src/profile_serial.c)
```

## sysbuild.conf
```
# Partitioning comes from the devicetree (boards/*.overlay including the
# dts/softsim/ layouts). To build with the deprecated Partition Manager
# instead, pass -DSB_CONFIG_PARTITION_MANAGER=y.

SB_CONFIG_SOFTSIM_BUNDLE_TEMPLATE_HEX=y
```

## prj.conf
```kconfig
# --- SoftSIM profile source -------------------------------------------------
# Default: EXTERNAL - the device waits for a profile over serial on first boot,
# provisions it, then reboots.
#
# For STATIC mode, uncomment the two lines below and replace the profile string with
# your Onomondo SoftSIM profile (hex string, as printed by `./softsim next` of the SoftSIM CLI Tool).
# CONFIG_SOFTSIM_STATIC_PROFILE_ENABLE=y
# CONFIG_SOFTSIM_STATIC_PROFILE="01120809101010325476980214980010325476981032140320000000000000000000000000000000000420000102030405060708090A0B0C0D0E0F0520000102030405060708090A0B0C0D0E0F0620000102030405060708090A0B0C0D0E0F"

# Configured to allow a reboot following the provisioning of a profile
CONFIG_REBOOT=y

CONFIG_LOG=y

# SoftSIM debug logging
# CONFIG_SOFTSIM_NRF_DEBUG_LOGS=y
# CONFIG_SOFTSIM_LIBS_DEBUG_LOGS=y

# Lossless library trace (debug only, baudrate 1000000); see SOFTSIM_LOG_IMMEDIATE_MODE Kconfig help.
# CONFIG_LOG_MODE_IMMEDIATE=y

# Factory reset the modem - helpful for development when the modem may be in an unknown state.
# CONFIG_SOFTSIM_FACTORY_RESET_ON_PROVISION=y

# nRF modem library logging, linking the log-capable modem-library when enabled.
# CONFIG_NRF_MODEM_LOG=y
# CONFIG_NRF_MODEM_LIB_LOG_LEVEL_DBG=y

# NET Configurations
CONFIG_NETWORKING=y
CONFIG_NET_SOCKETS=y
CONFIG_NET_NATIVE=n
CONFIG_NET_SOCKETS_OFFLOAD=y
CONFIG_POSIX_API=y

# LTE Configurations
CONFIG_LTE_LINK_CONTROL=y
CONFIG_LTE_LC_PSM_MODULE=y
CONFIG_LTE_LC_EDRX_MODULE=y

# Kernel heap for this application's own allocation: the profile buffer in
# main.c. SoftSIM does not set CONFIG_HEAP_MEM_POOL_SIZE -- it allocates from
# CONFIG_SOFTSIM_HEAP_SIZE -- so sizing this one is the application's job.
CONFIG_HEAP_MEM_POOL_SIZE=2048

# AT host library
CONFIG_AT_HOST_LIBRARY=y
CONFIG_UART_INTERRUPT_DRIVEN=y

# Reduce the size of TF-M by disabling the PS
CONFIG_TFM_PARTITION_PROTECTED_STORAGE=n
CONFIG_PSA_CRYPTO_DRIVER_CC3XX=n

# For DFU with MCUboot on the DKs, build with the MCUboot devicetree layout:
#   west build --sysbuild -b <board> -- -DSB_CONFIG_BOOTLOADER_MCUBOOT=y \
#     -DEXTRA_DTC_OVERLAY_FILE=mcuboot-partitions.overlay
```

## overlay-heap-stats.conf
```kconfig
# Logs SoftSIM's private heap each time its peak grows, naming the APDU.
# Build: west build --sysbuild -b <board> -- -DEXTRA_CONF_FILE=overlay-heap-stats.conf
CONFIG_SOFTSIM_HEAP_STATS=y
```

## overlay-manual-init.conf
```kconfig
# Manual init mode overlay: the application brings SoftSIM up itself instead of
# the module's SYS_INIT, which is what runtime SIM selection needs.
# Build with: west build --sysbuild -b <board> -- -DEXTRA_CONF_FILE=overlay-manual-init.conf
CONFIG_SOFTSIM_AUTO_INIT=n
```

## overlay-static.conf
```kconfig
# Static-profile mode overlay (for CI / reproducible builds - developers can
# instead just uncomment the static lines in prj.conf).
# Build with: west build --sysbuild -b <board> -- -DEXTRA_CONF_FILE=overlay-static.conf
CONFIG_SOFTSIM_STATIC_PROFILE_ENABLE=y
# GSMA TS.48 test profile - replace with your Onomondo SoftSIM profile.
CONFIG_SOFTSIM_STATIC_PROFILE="01120809101010325476980214980010325476981032140320000000000000000000000000000000000420000102030405060708090A0B0C0D0E0F0520000102030405060708090A0B0C0D0E0F0620000102030405060708090A0B0C0D0E0F"
```

## overlay-thread-analyzer.conf
```kconfig
# Logs every thread's stack high-water mark, by name, every 30 s.
# Build: west build --sysbuild -b <board> -- -DEXTRA_CONF_FILE=overlay-thread-analyzer.conf
CONFIG_THREAD_ANALYZER=y
CONFIG_THREAD_ANALYZER_AUTO=y
CONFIG_THREAD_ANALYZER_AUTO_INTERVAL=30
CONFIG_THREAD_NAME=y
# Timestamped log lines rather than printk; LOG_DEFAULT_LEVEL is ERR under SOFTSIM.
CONFIG_THREAD_ANALYZER_USE_LOG=y
CONFIG_THREAD_ANALYZER_LOG_LEVEL_INF=y
# Headroom for a ~20-message pass sharing the buffer with AT responses.
# A SOFTSIM_*_DEBUG_LOGS build needs its larger default instead: drop this line.
CONFIG_LOG_BUFFER_SIZE=4096
```

## mcuboot-partitions.overlay
```dts
/*
 * SPDX-FileCopyrightText: Copyright (c) 2026 Onomondo ApS
 * SPDX-License-Identifier: GPL-3.0-only
 *
 * Opt-in MCUboot (DFU) partition layout for the nRF91 DKs. Applied after the
 * board overlay, it replaces the no-bootloader layout. Build with:
 *
 *   west build --sysbuild -b <board> -- \
 *     -DSB_CONFIG_BOOTLOADER_MCUBOOT=y \
 *     -DEXTRA_DTC_OVERLAY_FILE=mcuboot-partitions.overlay
 *
 * boot/slot0/slot1 match the stock nRF91 layout, so the MCUboot image itself
 * builds with the unmodified board devicetree.
 */

#include <softsim/nrf91_softsim_mcuboot_partitions.dtsi>
```

## boards/nrf9160dk_nrf9160_ns.overlay
```dts
/*
 * SPDX-FileCopyrightText: Copyright (c) 2026 Onomondo ApS
 * SPDX-License-Identifier: GPL-3.0-only
 */

#include <softsim/nrf91_softsim_partitions.dtsi>
#include <softsim/nrf91_softsim_sram.dtsi>
```

## boards/thingy91_nrf9160_ns.overlay
```dts
/*
 * SPDX-FileCopyrightText: Copyright (c) 2026 Onomondo ApS
 * SPDX-License-Identifier: GPL-3.0-only
 */

#include <softsim/thingy91_softsim_partitions.dtsi>
#include <softsim/nrf91_softsim_sram.dtsi>
```

## boards/thingy91x_nrf9151_ns.overlay
```dts
/*
 * SPDX-FileCopyrightText: Copyright (c) 2026 Onomondo ApS
 * SPDX-License-Identifier: GPL-3.0-only
 */

#include <softsim/thingy91x_softsim_partitions.dtsi>
#include <softsim/nrf91_softsim_sram.dtsi>
```

## src/main.c
```c
/*
 * SPDX-FileCopyrightText: Copyright (c) 2023-2026 Onomondo ApS
 * SPDX-License-Identifier: GPL-3.0-only
 */

#include <stdio.h>
#include <unistd.h>
#include <sys/socket.h>
#include <arpa/inet.h>

#include <nrf_softsim.h>
#include <modem/lte_lc.h>
#include <modem/nrf_modem_lib.h>
#include <nrf_modem_at.h>
#include <zephyr/kernel.h>
#include <zephyr/net/socket.h>
#include <zephyr/device.h>
#include <zephyr/drivers/uart.h>
#include <zephyr/logging/log.h>
#include <zephyr/logging/log_ctrl.h>
#include <zephyr/sys/reboot.h>

#include "profile_serial.h"

LOG_MODULE_REGISTER(softsim_sample, LOG_LEVEL_INF);

/* Headroom over the full SoftSIM profile (~410 chars incl. SMSP/PIN/SMSC) */
#define PROFILE_MAX_SIZE 512

K_SEM_DEFINE(lte_connected, 0, 1); /* Semaphore to signal LTE connection established */

static int client_fd;
static struct sockaddr_storage host_addr;
static struct k_work_delayable server_transmission_work;
static const struct device *const uart_dev = DEVICE_DT_GET(DT_NODELABEL(uart0));

static void server_transmission_work_fn(struct k_work *work)
{
	char buffer[] = "{\"message\":\"Hello from Onomondo!\"}";

	int err = send(client_fd, buffer, sizeof(buffer) - 1, 0);

	if (err < 0) {
		LOG_ERR("Failed to transmit UDP packet, %d", errno);
		k_work_schedule(&server_transmission_work, K_SECONDS(2));
		return;
	}

	k_work_schedule(&server_transmission_work, K_SECONDS(150));
}

static void work_init(void)
{
	k_work_init_delayable(&server_transmission_work, server_transmission_work_fn);
}

static void lte_handler(const struct lte_lc_evt *const evt)
{
	switch (evt->type) {
	case LTE_LC_EVT_NW_REG_STATUS:
		if ((evt->nw_reg_status != LTE_LC_NW_REG_REGISTERED_HOME) &&
		    (evt->nw_reg_status != LTE_LC_NW_REG_REGISTERED_ROAMING)) {
			break;
		}

		LOG_INF("Network registration status: %s",
			evt->nw_reg_status == LTE_LC_NW_REG_REGISTERED_HOME
				? "Connected - home network"
				: "Connected - roaming");
		k_sem_give(&lte_connected);
		break;
	case LTE_LC_EVT_PSM_UPDATE:
		LOG_INF("PSM parameter update: TAU: %d, Active time: %d", evt->psm_cfg.tau,
			evt->psm_cfg.active_time);
		break;
	case LTE_LC_EVT_EDRX_UPDATE: {
		char log_buf[60];
		ssize_t len;

		len = snprintf(log_buf, sizeof(log_buf), "eDRX parameter update: eDRX: %f, PTW: %f",
			       (double)evt->edrx_cfg.edrx, (double)evt->edrx_cfg.ptw);
		if (len > 0) {
			LOG_INF("%s", log_buf);
		}
		break;
	}
	case LTE_LC_EVT_RRC_UPDATE:
		LOG_INF("RRC mode: %s",
			evt->rrc_mode == LTE_LC_RRC_MODE_CONNECTED ? "Connected" : "Idle");
		break;
	case LTE_LC_EVT_CELL_UPDATE:
		LOG_INF("LTE cell changed: Cell ID: %d, Tracking area: %d", evt->cell.id,
			evt->cell.tac);
		break;
	default:
		break;
	}
}

static void modem_connect(void)
{
	int err = lte_lc_connect_async(lte_handler);
	if (err) {
		LOG_ERR("Connecting to LTE network failed, error: %d", err);
		return;
	}
}

static void server_disconnect(void)
{
	(void)close(client_fd);
}

static int server_init(void)
{
	struct sockaddr_in *server4 = ((struct sockaddr_in *)&host_addr);

	server4->sin_family = AF_INET;
	server4->sin_port = htons(4321);

	inet_pton(AF_INET, "1.2.3.4", &server4->sin_addr);

	return 0;
}

static int server_connect(void)
{
	int err;

	client_fd = socket(AF_INET, SOCK_DGRAM, IPPROTO_UDP);
	if (client_fd < 0) {
		LOG_ERR("Failed to create UDP socket: %d", errno);
		err = -errno;
		goto error;
	}

	err = connect(client_fd, (struct sockaddr *)&host_addr, sizeof(struct sockaddr_in));
	if (err < 0) {
		LOG_ERR("Connect failed : %d", errno);
		goto error;
	}

	return 0;

error:
	server_disconnect();
	return err;
}

static void drain_logs_and_reboot(void)
{
	/* Flush the deferred log buffer over UART before the reboot discards it. */
	while (log_data_pending()) {
		log_process();
		k_yield();
	}
	sys_reboot(0);
}

static int provision_softsim_from_serial(void)
{
	if (!device_is_ready(uart_dev)) {
		LOG_ERR("UART device not found!");
		return -1;
	}

	char *profile = k_malloc(PROFILE_MAX_SIZE);

	if (profile == NULL) {
		LOG_ERR("Out of heap for the profile buffer; raise CONFIG_HEAP_MEM_POOL_SIZE");
		return -1;
	}

	struct rx_buf_t rx = {
		.buf = profile,
		.len = PROFILE_MAX_SIZE,
		.pos = 0,
	};

	uart_irq_callback_user_data_set(uart_dev, serial_cb, &rx);
	uart_irq_rx_enable(uart_dev);

	do {
		LOG_INF("Transfer SoftSIM profile using serial COM port, terminate by "
			"newline character (return key)");
	} while (k_sem_take(&profile_received, K_SECONDS(20)));

	LOG_INF("Profile received: %zu characters in total", rx.pos);

	uart_irq_rx_disable(uart_dev);

	/* Provision the profile to the SoftSIM filesystem */
	if (nrf_softsim_provision((uint8_t *)profile, rx.pos) != 0) {
		LOG_ERR("SoftSIM Profile provisioning failed");
	}

	k_free(profile);

#ifndef CONFIG_SOFTSIM_FACTORY_RESET_ON_PROVISION
	/* Reboot to free the UART for the AT host/monitor and bring the modem up
	 * cleanly with the new SIM. With factory reset enabled we must NOT reboot
	 * here: the modem is still uninitialised (AT commands return -NRF_EPERM, i.e.
	 * -1), so the reset waits until main() has called nrf_modem_lib_init() — see
	 * nrf_softsim_just_provisioned(). */
	drain_logs_and_reboot();
#endif /* !CONFIG_SOFTSIM_FACTORY_RESET_ON_PROVISION */

	return 0;
}

int main(void)
{
	LOG_INF("SoftSIM sample started.");

#ifndef CONFIG_SOFTSIM_AUTO_INIT
	/* Without auto-init the module's SYS_INIT is compiled out, so bring SoftSIM
	 * up here -- before nrf_softsim_check_provisioned(), which needs the
	 * filesystem this initializes. */
	if (nrf_softsim_init()) {
		LOG_ERR("Failed to initialize SoftSIM.");
		return -1;
	}
#endif

	if (!nrf_softsim_check_provisioned()) {
		if (provision_softsim_from_serial() != 0) {
			return -1;
		}
	}

	int32_t err = nrf_modem_lib_init();
	if (err) {
		LOG_ERR("Failed to initialize modem library, error: %d", err);
	}

#ifndef CONFIG_SOFTSIM_AUTO_INIT
	/* The module's NRF_MODEM_LIB_ON_INIT hook is compiled out too, so select the
	 * software SIM here. Runtime SIM selection lives at this point: send this
	 * only when a profile is provisioned, and the device falls back to a
	 * physical SIM otherwise. */
	if (nrf_modem_at_printf("AT%%CSUS=2")) {
		LOG_ERR("Failed to select software SIM.");
	}
#endif

#ifdef CONFIG_SOFTSIM_FACTORY_RESET_ON_PROVISION
	/* Modem is now initialised; if a profile was just provisioned (static or
	 * serial), wipe modem NVM and reboot so it comes up clean with the new SIM. */
	if (!err && nrf_softsim_just_provisioned()) {
		nrf_softsim_modem_factory_reset();
		drain_logs_and_reboot();
	}
#endif /* CONFIG_SOFTSIM_FACTORY_RESET_ON_PROVISION */

	work_init();

	modem_connect();

	LOG_INF("Waiting for LTE connect event.");
	do {
	} while (k_sem_take(&lte_connected, K_SECONDS(10)));

	LOG_INF("LTE connected!");
	err = server_init();
	if (err) {
		LOG_ERR("Not able to initialize UDP server connection");
		return -1;
	}

	err = server_connect();
	if (err) {
		LOG_ERR("Not able to connect to UDP server");
		return -1;
	}

	k_work_schedule(&server_transmission_work, K_NO_WAIT);
}
```

## src/profile_serial.c
```c
/*
 * SPDX-FileCopyrightText: Copyright (c) 2026 Onomondo ApS
 * SPDX-License-Identifier: GPL-3.0-only
 */

#include "profile_serial.h"

#include <zephyr/drivers/uart.h>

K_SEM_DEFINE(profile_received, 0, 1);

void serial_cb(const struct device *dev, void *user_data)
{
	struct rx_buf_t *rx = (struct rx_buf_t *)user_data;
	char *rx_buf = rx->buf;
	size_t *rx_buf_pos = &rx->pos;
	uint8_t c;

	if (!uart_irq_update(dev)) {
		return;
	}

	/* Read before deciding what to do with the byte: uart_fifo_read() is what
	 * acknowledges the RX interrupt, so returning with a byte still pending would
	 * re-enter this ISR immediately and starve the thread waiting on the profile. */
	while (uart_fifo_read(dev, &c, 1) == 1) {
		/* Stop on the terminator, or once the buffer is full -- keeping room for
		 * the NUL -- rather than overflowing it. Mask RX before signalling so the
		 * buffer cannot be mutated while main() reads it. */
		if ((c == '\n') || (c == '\r') || (*rx_buf_pos == rx->len - 1)) {
			rx_buf[*rx_buf_pos] = 0;
			uart_irq_rx_disable(dev);
			k_sem_give(&profile_received);
			return;
		}

		rx_buf[(*rx_buf_pos)++] = c;
	}
}
```

## src/profile_serial.h
```c
/*
 * SPDX-FileCopyrightText: Copyright (c) 2026 Onomondo ApS
 * SPDX-License-Identifier: GPL-3.0-only
 */

#ifndef PROFILE_SERIAL_H
#define PROFILE_SERIAL_H

#include <zephyr/device.h>
#include <zephyr/kernel.h>

/* Receive buffer handed to serial_cb() as user data. */
struct rx_buf_t {
	char *buf;
	size_t len;
	size_t pos;
};

/* Given by serial_cb() once the profile string in the buffer is terminated. */
extern struct k_sem profile_received;

void serial_cb(const struct device *dev, void *user_data);

#endif /* PROFILE_SERIAL_H */
```
