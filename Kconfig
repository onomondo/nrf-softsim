## tests/fuzz/sms_ota/testcase.yaml
```yaml
tests:
  softsim.fuzz.sms_ota:
    toolchain_allow: llvm
    platform_allow:
      - native_sim/native/64
    integration_platforms:
      - native_sim/native/64
    build_only: true
    tags:
      - softsim
      - softsim_fuzz
```

## tests/fuzz/transact/testcase.yaml
```yaml
tests:
  softsim.fuzz.transact:
    toolchain_allow: llvm
    platform_allow:
      - native_sim/native/64
    integration_platforms:
      - native_sim/native/64
    build_only: true
    tags:
      - softsim
      - softsim_fuzz
```

## tests/handler/testcase.yaml
```yaml
tests:
  softsim.unit.handler:
    platform_allow:
      - native_sim
    integration_platforms:
      - native_sim
    tags:
      - softsim
      - ci_tests_softsim_unit
```
