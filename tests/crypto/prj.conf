## CMakeLists.txt
```
# SPDX-FileCopyrightText: Copyright (c) 2026 Onomondo ApS
# SPDX-License-Identifier: GPL-3.0-only

cmake_minimum_required(VERSION 3.20.0)
find_package(Zephyr REQUIRED HINTS $ENV{ZEPHYR_BASE})
project(softsim_crypto_test)

set(SOFTSIM_LIB ${CMAKE_CURRENT_LIST_DIR}/../../lib)

# ss_crypto.c talks to PSA and nothing else -- no TF-M API calls, no
# nrf-specific headers -- so the same file the firmware compiles runs here
# against Mbed TLS's PSA implementation. The keys are plain persistent
# PSA key ids (10, 11, 12), which is what makes this testable off-target.
target_sources(app PRIVATE
  src/main.c
  src/ram_its_store.c
  ${SOFTSIM_LIB}/ss_crypto.c
  ${SOFTSIM_LIB}/ss_heap.c
  ${SOFTSIM_LIB}/ss_logp_zephyr.c
)

target_include_directories(app PRIVATE
  ${SOFTSIM_LIB}
  ${SOFTSIM_LIB}/include
  ${SOFTSIM_LIB}/onomondo-uicc/include
)

# No CONFIG_SOFTSIM_LIBS_LOG_LEVEL: the log-level symbols sit at the top level
# of the module Kconfig, so autoconf.h already defines both, and a -D with a
# different value is a redefinition error. 3 is what autoconf derives, so this
# one matches byte for byte and stays for parity with the other suites.
target_compile_definitions(app PRIVATE CONFIG_SOFTSIM_NRF_LOG_LEVEL=3)

# secure_storage_its_store_*() are declared in an internal header that the
# subsystem does not export to applications.
target_include_directories(app PRIVATE
  ${ZEPHYR_BASE}/subsys/secure_storage/include/internal
)
```

## prj.conf
```kconfig
CONFIG_ZTEST=y
CONFIG_ASSERT=y

# No CONFIG_HEAP_MEM_POOL_SIZE: ss_heap.c allocates from SoftSIM's own heap.

# PSA crypto, provided off-target by Mbed TLS rather than TF-M. The algorithm
# set is what ss_crypto.c asks for: AES-CBC without padding for the cipher
# helpers, CMAC for the OTA cryptographic checksum.
CONFIG_PSA_CRYPTO=y
CONFIG_PSA_WANT_KEY_TYPE_AES=y
CONFIG_PSA_WANT_ALG_CBC_NO_PADDING=y
CONFIG_PSA_WANT_ALG_CMAC=y
CONFIG_MBEDTLS_ENABLE_HEAP=y
CONFIG_MBEDTLS_HEAP_SIZE=4096
# PSA copies every buffer, as TF-M does on target; in place, that exposes an
# output size that covers unread input.
CONFIG_MBEDTLS_PSA_ASSUME_EXCLUSIVE_BUFFERS=n

# psa_import_key() is called with PSA_KEY_LIFETIME_PERSISTENT, so the key store
# has to exist. The custom backend in src/ram_its_store.c keeps it in RAM: the
# alternatives are settings/NVS or ZMS, which would drag in the flash simulator
# and with it the UBSan exclusion the storage suites need.
CONFIG_SECURE_STORAGE=y
CONFIG_SECURE_STORAGE_ITS_STORE_IMPLEMENTATION_CUSTOM=y

# Key derivation inside the PSA core wants entropy; native_sim has no hardware
# source, so use the same non-cryptographic stand-in Zephyr's own PSA tests use.
CONFIG_ENTROPY_GENERATOR=y
CONFIG_TEST_RANDOM_GENERATOR=y
CONFIG_MBEDTLS_PSA_CRYPTO_EXTERNAL_RNG_ALLOW_NON_CSPRNG=y
```

## src/main.c
```c
/*
 * SPDX-FileCopyrightText: Copyright (c) 2026 Onomondo ApS
 * SPDX-License-Identifier: GPL-3.0-only
 *
 * Tests for lib/ss_crypto.c -- the PSA glue that holds KI, KIC and KID and does
 * every AES and CMAC operation the card performs.
 *
 * On target the keys live in TF-M's Internal Trusted Storage; here the same file runs
 * against Mbed TLS's PSA implementation, because the keys are ordinary
 * persistent PSA key ids and the file touches no nrf-specific API. The keys are
 * therefore real keys, the ciphertext is real ciphertext, and the vectors below
 * were computed independently (Python cryptography, AES-128) rather than by
 * recording what this code produces.
 *
 * Several cases document defects instead of passing: the error paths in here
 * swallow PSA failures and return success, which on a device means a card that
 * looks provisioned and cannot authenticate.
 */

#include <stdint.h>
#include <string.h>

#include <psa/crypto.h>
#include <zephyr/ztest.h>

#include "ss_crypto.h"
#include <onomondo/utils/ss_profile.h>

/* KI = KIC = KID = 000102..0f, as the GSMA TS.48 test profile carries them. */
static const uint8_t test_key[AES_KEY_SIZE] = {0x00, 0x01, 0x02, 0x03, 0x04, 0x05, 0x06, 0x07,
					       0x08, 0x09, 0x0a, 0x0b, 0x0c, 0x0d, 0x0e, 0x0f};

/* Two AES blocks of plaintext and its AES-128-CBC encryption under the key
 * above with the all-zero IV the telecom specs mandate. */
static const uint8_t plaintext[32] = {0x10, 0x11, 0x12, 0x13, 0x14, 0x15, 0x16, 0x17,
				      0x18, 0x19, 0x1a, 0x1b, 0x1c, 0x1d, 0x1e, 0x1f,
				      0x20, 0x21, 0x22, 0x23, 0x24, 0x25, 0x26, 0x27,
				      0x28, 0x29, 0x2a, 0x2b, 0x2c, 0x2d, 0x2e, 0x2f};
static const uint8_t ciphertext[32] = {0x07, 0xfe, 0xef, 0x74, 0xe1, 0xd5, 0x03, 0x6e,
				       0x90, 0x0e, 0xee, 0x11, 0x8e, 0x94, 0x92, 0x93,
				       0x13, 0x8b, 0xb0, 0xfe, 0x94, 0x25, 0x20, 0xa0,
				       0x01, 0x3f, 0x42, 0x53, 0x1d, 0xd5, 0x02, 0x2c};

/* The OTA checksum runs CMAC over data1 followed by data2. */
static const uint8_t cmac_data1[16] = {0xa0, 0xa1, 0xa2, 0xa3, 0xa4, 0xa5, 0xa6, 0xa7,
				       0xa8, 0xa9, 0xaa, 0xab, 0xac, 0xad, 0xae, 0xaf};
static const uint8_t cmac_data2[16] = {0xb0, 0xb1, 0xb2, 0xb3, 0xb4, 0xb5, 0xb6, 0xb7,
				       0xb8, 0xb9, 0xba, 0xbb, 0xbc, 0xbd, 0xbe, 0xbf};
static const uint8_t cmac_golden[16] = {0xcd, 0xb6, 0x8c, 0xa8, 0x77, 0x2c, 0x22, 0x12,
					0x47, 0xd6, 0xec, 0xa1, 0x96, 0xe2, 0x9d, 0x03};

/* The cipher helpers take the key by its profile tag, not by key id: the first
 * byte of the "key" they are handed is the tag stored in EF.A001/EF.A004, which
 * key_tag_to_psa_id() maps to a key id. */
static const uint8_t kic_ref[1] = {KIC_TAG};
static const uint8_t kid_ref[1] = {KID_TAG};

static void *suite_setup(void)
{
	zassume_equal(psa_crypto_init(), PSA_SUCCESS, "PSA crypto did not initialise");

	return NULL;
}

static void import_all_keys(void)
{
	uint8_t key[AES_KEY_SIZE];

	/* The signature takes a non-const key. */
	memcpy(key, test_key, sizeof(key));
	zassert_ok(ss_utils_setup_key(sizeof(key), key, KEY_ID_KI), "KI import failed");
	zassert_ok(ss_utils_setup_key(sizeof(key), key, KEY_ID_KIC), "KIC import failed");
	zassert_ok(ss_utils_setup_key(sizeof(key), key, KEY_ID_KID), "KID import failed");
}

static void test_before(void *fixture)
{
	ARG_UNUSED(fixture);

	/* Every slot starts empty, so a test can tell "imported" from "left over
	 * from the previous test". */
	psa_destroy_key((psa_key_id_t)KEY_ID_KI);
	psa_destroy_key((psa_key_id_t)KEY_ID_KIC);
	psa_destroy_key((psa_key_id_t)KEY_ID_KID);
}

ZTEST_SUITE(softsim_crypto, NULL, suite_setup, test_before, NULL, NULL);

/* --- key lifecycle --------------------------------------------------------- */

ZTEST(softsim_crypto, test_key_existence_follows_the_import)
{
	uint8_t key[AES_KEY_SIZE];

	memcpy(key, test_key, sizeof(key));

	zassert_equal(ss_utils_check_key_existence(KEY_ID_KI), 0, "KI existed before import");
	zassert_ok(ss_utils_setup_key(sizeof(key), key, KEY_ID_KI));
	zassert_equal(ss_utils_check_key_existence(KEY_ID_KI), 1, "KI was not found after import");

	/* Provisioning writes one key at a time, so the others must stay absent. */
	zassert_equal(ss_utils_check_key_existence(KEY_ID_KIC), 0, "KIC appeared on its own");
	zassert_equal(ss_utils_check_key_existence(KEY_ID_KID), 0, "KID appeared on its own");
}

/*
 * Re-provisioning a device imports over keys that already exist, which the
 * helper handles by destroying the old key first. PSA rejects an import onto an
 * occupied id, so without that destroy the second provisioning would silently
 * leave the old key in place.
 */
ZTEST(softsim_crypto, test_importing_over_an_existing_key_replaces_it)
{
	uint8_t key[AES_KEY_SIZE];
	uint8_t buf[sizeof(plaintext)];

	memcpy(key, test_key, sizeof(key));
	zassert_ok(ss_utils_setup_key(sizeof(key), key, KEY_ID_KIC));

	/* A different key the second time round. */
	for (size_t i = 0; i < sizeof(key); i++) {
		key[i] = (uint8_t)(0xf0 + i);
	}
	zassert_ok(ss_utils_setup_key(sizeof(key), key, KEY_ID_KIC), "re-import failed");
	zassert_equal(ss_utils_check_key_existence(KEY_ID_KIC), 1);

	/* The stored key must be the new one, so the old key's ciphertext is no
	 * longer what comes out. */
	memcpy(buf, plaintext, sizeof(buf));
	ss_utils_aes_encrypt(buf, sizeof(buf), kic_ref, sizeof(kic_ref));
	zassert_true(memcmp(buf, ciphertext, sizeof(buf)) != 0,
		     "encryption still used the replaced key");
}

/* --- the cipher helpers ---------------------------------------------------- */

ZTEST(softsim_crypto, test_aes_encrypt_matches_the_known_vector)
{
	uint8_t buf[sizeof(plaintext)];

	import_all_keys();
	memcpy(buf, plaintext, sizeof(buf));

	ss_utils_aes_encrypt(buf, sizeof(buf), kic_ref, sizeof(kic_ref));

	zassert_mem_equal(buf, ciphertext, sizeof(ciphertext),
			  "AES-CBC encryption does not match the reference vector");
}

ZTEST(softsim_crypto, test_aes_decrypt_matches_the_known_vector)
{
	uint8_t buf[sizeof(ciphertext)];

	import_all_keys();
	memcpy(buf, ciphertext, sizeof(buf));

	ss_utils_aes_decrypt(buf, sizeof(buf), kic_ref, sizeof(kic_ref));

	zassert_mem_equal(buf, plaintext, sizeof(plaintext),
			  "AES-CBC decryption does not match the reference vector");
}

ZTEST(softsim_crypto, test_ota_checksum_matches_the_known_vector)
{
	uint8_t cc[8] = {0};
	uint8_t data1[sizeof(cmac_data1)];
	uint8_t data2[sizeof(cmac_data2)];

	import_all_keys();
	memcpy(data1, cmac_data1, sizeof(data1));
	memcpy(data2, cmac_data2, sizeof(data2));

	/* OTA security uses the leading 8 bytes of the CMAC as the checksum. */
	zassert_ok(ss_utils_ota_calc_cc(cc, sizeof(cc), (uint8_t *)kid_ref, sizeof(kid_ref),
					AES_CMAC, data1, sizeof(data1), data2, sizeof(data2)),
		   "CMAC calculation failed");

	zassert_mem_equal(cc, cmac_golden, sizeof(cc),
			  "the OTA checksum does not match the reference CMAC");
}

/*
 * The checksum is only defined for CMAC here, because this port implements AES-CMAC only.
 * Any other algorithm has to be refused rather than quietly producing something
 * an operator would reject.
 */
ZTEST(softsim_crypto, test_ota_checksum_refuses_other_algorithms)
{
	uint8_t cc[8] = {0};
	uint8_t data1[sizeof(cmac_data1)];
	uint8_t data2[sizeof(cmac_data2)];

	import_all_keys();
	memcpy(data1, cmac_data1, sizeof(data1));
	memcpy(data2, cmac_data2, sizeof(data2));

	zassert_true(ss_utils_ota_calc_cc(cc, sizeof(cc), (uint8_t *)kid_ref, sizeof(kid_ref),
					  TRIPLE_DES_CBC2, data1, sizeof(data1), data2,
					  sizeof(data2)) != 0,
		     "3DES CMAC was accepted");

	/* The checksum key must be KID: KIC has no signing usage flag. */
	zassert_true(ss_utils_ota_calc_cc(cc, sizeof(cc), (uint8_t *)kic_ref, sizeof(kic_ref),
					  AES_CMAC, data1, sizeof(data1), data2,
					  sizeof(data2)) != 0,
		     "a non-KID key was accepted for the OTA checksum");
}

ZTEST(softsim_crypto, test_an_unknown_key_tag_leaves_the_buffer_alone)
{
	uint8_t buf[sizeof(plaintext)];
	const uint8_t bogus_ref[1] = {0x7f};

	import_all_keys();
	memcpy(buf, plaintext, sizeof(buf));

	ss_utils_aes_encrypt(buf, sizeof(buf), bogus_ref, sizeof(bogus_ref));

	zassert_mem_equal(buf, plaintext, sizeof(plaintext),
			  "an unresolvable key tag still modified the buffer");
}

/*
 * The helpers cipher the caller's buffer block by block, so no payload is too
 * long for them: 512 bytes, about four concatenated-SMS parts of OTA command,
 * cipher fully and round-trip. The last block pins the CBC chain across all 32
 * blocks against an independently computed vector (same key, zero IV); the
 * round trip catches a block that was ciphered but never written back.
 */
ZTEST(softsim_crypto, test_an_oversized_buffer_is_not_silently_left_in_the_clear)
{
	static uint8_t buf[512];
	static uint8_t original[512];
	static const uint8_t last_block[AES_BLOCKSIZE] = {0x04, 0x01, 0x52, 0x6b, 0xc5, 0xdc,
							  0xc3, 0xa3, 0x6f, 0x6b, 0xe4, 0xd4,
							  0x1e, 0x53, 0x19, 0x22};

	import_all_keys();
	for (size_t i = 0; i < sizeof(buf); i++) {
		buf[i] = (uint8_t)i;
	}
	memcpy(original, buf, sizeof(original));

	ss_utils_aes_encrypt(buf, sizeof(buf), kic_ref, sizeof(kic_ref));
	zassert_mem_equal(buf + sizeof(buf) - AES_BLOCKSIZE, last_block, AES_BLOCKSIZE,
			  "the last CBC block differs from the reference vector");

	ss_utils_aes_decrypt(buf, sizeof(buf), kic_ref, sizeof(kic_ref));
	zassert_mem_equal(buf, original, sizeof(buf), "a 512-byte buffer did not round-trip");
}

/* --- documented defects ---------------------------------------------------- */

/*
 * Known defect. ss_utils_setup_key() ignores what the import helper returns and
 * always reports success, and nrf_softsim_provision() then logs that the keys
 * were written and carries on to write the IMSI. A device whose key import
 * failed therefore looks provisioned and can never authenticate -- the one
 * failure mode that cannot be recovered from the field.
 *
 * The import is made to fail by filling the key store first, which is a real
 * failure mode (TF-M's ITS holds CONFIG_TFM_ITS_NUM_ASSETS assets) and keeps the key itself
 * valid, so the length assertions inside the function are not what trips.
 *
 * Expected to fail until the return value is propagated.
 */
ZTEST(softsim_crypto, test_a_failed_key_import_is_reported)
{
	uint8_t key[AES_KEY_SIZE];
	psa_key_id_t filler_base = 100;
	unsigned int filled = 0;

	memcpy(key, test_key, sizeof(key));

	/* Occupy the store until it refuses another persistent key. */
	for (unsigned int i = 0; i < 32; i++) {
		psa_key_attributes_t attr = PSA_KEY_ATTRIBUTES_INIT;
		psa_key_id_t out;

		psa_set_key_usage_flags(&attr, PSA_KEY_USAGE_ENCRYPT);
		psa_set_key_algorithm(&attr, PSA_ALG_CBC_NO_PADDING);
		psa_set_key_type(&attr, PSA_KEY_TYPE_AES);
		psa_set_key_bits(&attr, 128);
		psa_set_key_lifetime(&attr, PSA_KEY_LIFETIME_PERSISTENT);
		psa_set_key_id(&attr, filler_base + i);

		if (psa_import_key(&attr, key, sizeof(key), &out) != PSA_SUCCESS) {
			psa_reset_key_attributes(&attr);
			break;
		}
		psa_reset_key_attributes(&attr);
		filled++;
	}
	zassume_true(filled > 0 && filled < 32, "could not fill the key store (%u)", filled);

	const int rc = ss_utils_setup_key(sizeof(key), key, KEY_ID_KI);
	const int exists = ss_utils_check_key_existence(KEY_ID_KI);

	for (unsigned int i = 0; i < filled; i++) {
		psa_destroy_key(filler_base + i);
	}

	zassert_equal(exists, 0, "the import was expected to fail but the key is present");
	zassert_true(rc != 0, "ss_utils_setup_key() reported a failed import as success");
}
ZTEST_EXPECT_FAIL(softsim_crypto, test_a_failed_key_import_is_reported);

/*
 * Known defect. 3DES support was dropped by making both helpers return without
 * touching the buffer, so a profile that expects 3DES OTA security gets
 * plaintext where ciphertext is required, silently. Returning an error, or not
 * offering the symbols at all, would at least surface it.
 *
 * Expected to fail until they report the lack of support.
 */
ZTEST(softsim_crypto, test_3des_does_not_pretend_to_encrypt)
{
	uint8_t buf[sizeof(plaintext)];

	memcpy(buf, plaintext, sizeof(buf));

	ss_utils_3des_encrypt(buf, sizeof(buf), test_key);

	zassert_true(memcmp(buf, plaintext, sizeof(buf)) != 0,
		     "ss_utils_3des_encrypt() left the plaintext untouched");
}
ZTEST_EXPECT_FAIL(softsim_crypto, test_3des_does_not_pretend_to_encrypt);
```

## src/ram_its_store.c
```c
/*
 * SPDX-FileCopyrightText: Copyright (c) 2026 Onomondo ApS
 * SPDX-License-Identifier: GPL-3.0-only
 *
 * A RAM-backed internal trusted storage backend, so PSA can hold the persistent
 * keys ss_crypto.c imports without a flash device. Modelled on the custom store
 * in zephyr/tests/subsys/secure_storage/psa/its.
 *
 * Keys do not need to survive a reboot for these tests -- what matters is that
 * PSA_KEY_LIFETIME_PERSISTENT is accepted and that a key stays retrievable
 * across calls, which is what TF-M's ITS provides on target.
 */

#include <string.h>

#include <zephyr/secure_storage/its/store.h>
#include <zephyr/sys/util.h>

static struct {
	secure_storage_its_uid_t uid;
	size_t data_length;
	uint8_t data[SECURE_STORAGE_ITS_TRANSFORM_MAX_STORED_DATA_SIZE];
} entries[8];

static int find(secure_storage_its_uid_t uid)
{
	for (unsigned int i = 0; i < ARRAY_SIZE(entries); i++) {
		if (memcmp(&uid, &entries[i].uid, sizeof(uid)) == 0) {
			return (int)i;
		}
	}

	return -1;
}

psa_status_t secure_storage_its_store_set(secure_storage_its_uid_t uid, size_t data_length,
					  const void *data)
{
	int index = find(uid);

	if (data_length > sizeof(entries[0].data)) {
		return PSA_ERROR_INSUFFICIENT_STORAGE;
	}

	if (index == -1) {
		for (unsigned int i = 0; i < ARRAY_SIZE(entries); i++) {
			if (entries[i].uid.uid == 0) {
				index = (int)i;
				break;
			}
		}
		if (index == -1) {
			return PSA_ERROR_INSUFFICIENT_STORAGE;
		}
		entries[index].uid = uid;
	}

	entries[index].data_length = data_length;
	memcpy(entries[index].data, data, data_length);

	return PSA_SUCCESS;
}

psa_status_t secure_storage_its_store_get(secure_storage_its_uid_t uid, size_t data_size,
					  void *data, size_t *data_length)
{
	const int index = find(uid);

	if (index == -1) {
		return PSA_ERROR_DOES_NOT_EXIST;
	}

	*data_length = MIN(data_size, entries[index].data_length);
	memcpy(data, entries[index].data, *data_length);

	return PSA_SUCCESS;
}

psa_status_t secure_storage_its_store_remove(secure_storage_its_uid_t uid)
{
	const int index = find(uid);

	if (index == -1) {
		return PSA_ERROR_DOES_NOT_EXIST;
	}

	entries[index].uid.uid = 0;

	return PSA_SUCCESS;
}
```
