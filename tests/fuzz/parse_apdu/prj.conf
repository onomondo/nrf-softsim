## CMakeLists.txt
```
# SPDX-FileCopyrightText: Copyright (c) 2026 Onomondo ApS
# SPDX-License-Identifier: GPL-3.0-only

cmake_minimum_required(VERSION 3.20.0)
find_package(Zephyr REQUIRED HINTS $ENV{ZEPHYR_BASE})
project(softsim_fuzz_parse_apdu)

include(${CMAKE_CURRENT_LIST_DIR}/../common/softsim_fuzz.cmake)

# system heap: SS_ALLOC -> malloc, so LSan sees leaks in the TLV decoders'
# linked lists (a decoder that leaks on malformed input is a real DoS vector).
softsim_fuzz_core(HEAP system)

# ss_profile_from_string lives in utils/, is self-contained (string.h only), and
# is compiled straight in the way tests/handler does -- no need for the utils lib.
target_sources(app PRIVATE
  ${SOFTSIM_FUZZ_COMMON}/fuzz_entry.c
  src/main.c
  ${SOFTSIM_LIB}/onomondo-uicc/utils/ss_profile.c
)

# The stateless parsers all live in libuicc and reach neither storage, crypto
# nor the filesystem (verified: no ss_storage_*/ss_fs_*/ss_crypto_* references),
# so link only that -- no fs backend needed, no undefined port hooks.
target_link_libraries(app PRIVATE uicc)
```

## prj.conf
```kconfig
# SPDX-FileCopyrightText: Copyright (c) 2026 Onomondo ApS
# SPDX-License-Identifier: GPL-3.0-only

# Build this app as an LLVM libfuzzer target (native_sim/native/64 + clang).
CONFIG_ARCH_POSIX_LIBFUZZER=y

# Keep Zephyr __ASSERT active. The core's own assert() comes from libc and is
# governed by NDEBUG (off in Twister debug builds), so its preconditions still
# fire -- the harness guards the ones it must not trip.
CONFIG_ASSERT=y

# No flash, NVS or heap pool: the stateless parsers use the host malloc (system
# heap) and touch no filesystem.
```

## src/main.c
```c
/*
 * SPDX-FileCopyrightText: Copyright (c) 2026 Onomondo ApS
 * SPDX-License-Identifier: GPL-3.0-only
 *
 * Stateless-parser fuzz target: the onomondo-uicc decoders that turn untrusted
 * bytes into structures, with no filesystem or context around them. One binary
 * multiplexes them -- the first input byte selects the decoder, the rest is its
 * input -- so the target (and binary) count stays low while coverage guidance
 * still keeps each decoder's corpus separable. Split one out if its corpus ever
 * needs isolation.
 *
 * Each case copies its input into an exactly-sized heap block so AddressSanitizer
 * red-zones it and catches reads one byte past the declared length -- the whole
 * point of fuzzing a length-driven parser. The decoders allocate through the
 * system heap here, so LeakSanitizer sees any list they leak on an error path.
 */

#include <stdint.h>
#include <stdlib.h>
#include <string.h>

#include <onomondo/utils/ss_profile.h>

#include "apdu.h"
#include "btlv.h"
#include "ctlv.h"
#include "tlv8.h"
#include "sms.h"
#include "fuzz_entry.h"

enum {
	FUZZ_APDU_PARSE,
	FUZZ_BTLV,
	FUZZ_CTLV,
	FUZZ_TLV8,
	FUZZ_SMS_HDR,
	FUZZ_PROFILE,
	FUZZ_TARGET_COUNT,
};

void fuzz_one(const uint8_t *data, size_t len)
{
	if (len < 1)
		return;

	uint8_t selector = data[0] % FUZZ_TARGET_COUNT;
	const uint8_t *in = data + 1;
	size_t in_len = len - 1;

	/* Exactly-sized copy so an over-read past in_len is a heap-buffer-overflow
	 * ASan can pin, not a silent read into slack. */
	uint8_t *buf = malloc(in_len ? in_len : 1);
	if (!buf)
		return;
	if (in_len)
		memcpy(buf, in, in_len);

	switch (selector) {
	case FUZZ_APDU_PARSE:
		/* ss_apdu_parse_exhaustive asserts len >= APDU_HEADER_SIZE; guard it
		 * so we fuzz the parse logic, not the assert. apdu.cmd[256] sits in
		 * this stack frame, so an over-long extended Lc overflows it -> ASan. */
		if (in_len >= APDU_HEADER_SIZE) {
			struct ss_apdu apdu;

			memset(&apdu, 0, sizeof(apdu));
			ss_apdu_parse_exhaustive(&apdu, buf, in_len);
		}
		break;
	case FUZZ_BTLV: {
		/* NULL descr: fuzz the raw decode rather than a specific IE table. */
		struct ss_list *l = ss_btlv_decode(buf, in_len, NULL);

		if (l)
			ss_btlv_free(l);
		break;
	}
	case FUZZ_CTLV: {
		struct ss_list *l = ss_ctlv_decode(buf, in_len);

		if (l)
			ss_ctlv_free(l);
		break;
	}
	case FUZZ_TLV8: {
		struct ss_list *l = ss_tlv8_decode(buf, in_len);

		if (l)
			ss_tlv8_free(l);
		break;
	}
	case FUZZ_SMS_HDR: {
		struct ss_sm_hdr hdr;

		memset(&hdr, 0, sizeof(hdr));
		ss_sms_hdr_decode(&hdr, buf, in_len);
		break;
	}
	case FUZZ_PROFILE:
		/* Reached in production only through nrf_softsim_provision(), which
		 * rejects len < 4; match that so a len<4 underflow is not charged
		 * against an unreachable path. buf is unterminated and exactly in_len
		 * long, so any read past len is caught. */
		if (in_len >= 4) {
			struct ss_profile profile;
			uint16_t n = in_len > UINT16_MAX ? UINT16_MAX : (uint16_t)in_len;

			memset(&profile, 0, sizeof(profile));
			ss_profile_from_string(n, (const char *)buf, &profile);
		}
		break;
	}

	free(buf);
}
```
