## CMakeLists.txt
```
# SPDX-FileCopyrightText: Copyright (c) 2026 Onomondo ApS
# SPDX-License-Identifier: GPL-3.0-only

cmake_minimum_required(VERSION 3.20.0)
find_package(Zephyr REQUIRED HINTS $ENV{ZEPHYR_BASE})
project(softsim_fuzz_transact)

include(${CMAKE_CURRENT_LIST_DIR}/../common/softsim_fuzz.cmake)

# port heap (k_malloc): the nRF filesystem port (ss_fs.c/ss_heap.c) is in the
# build, matching firmware; SS_ALLOC must map to the same heap it does there.
softsim_fuzz_core(HEAP port)

# The nRF port of the UICC filesystem, over Zephyr NVS on the flash simulator --
# the same layering tests/apdu pins, so the fuzzer drives the real storage path
# (DIR cache, sector rotation, path resolution) and not just the parser.
target_sources(app PRIVATE
  ${SOFTSIM_FUZZ_COMMON}/fuzz_entry.c
  src/main.c
  ${SOFTSIM_LIB}/ss_fs.c
  ${SOFTSIM_LIB}/ss_cache.c
  ${SOFTSIM_LIB}/ss_heap.c
)

target_link_libraries(app PRIVATE uicc storage milenage crypto)

target_compile_definitions(app PRIVATE
  CONFIG_SOFTSIM_NRF_LOG_LEVEL=3
  CONFIG_COMPACT_STORAGE=1
)

# The pre-populated filesystem image the firmware flashes at the nvs_storage
# partition base; fuzz_setup() writes it into the simulated flash.
generate_inc_file_for_target(app ${SOFTSIM_LIB}/profile/template.bin
  ${ZEPHYR_BINARY_DIR}/include/generated/template_bin.inc)

# Same off-target exemption tests/apdu/CMakeLists.txt applies to ss_fs.c: the
# Partition Manager shim (nrf/include/flash_map_pm.h, which defines
# FLASH_AREA_SIZE) is absent off-target, so map it to the devicetree size.
set_source_files_properties(${SOFTSIM_LIB}/ss_fs.c
  DIRECTORY ${CMAKE_CURRENT_LIST_DIR}
  PROPERTIES COMPILE_OPTIONS "-Wno-error;-DFLASH_AREA_SIZE(label)=PARTITION_SIZE(label)")
```

## prj.conf
```kconfig
# SPDX-FileCopyrightText: Copyright (c) 2026 Onomondo ApS
# SPDX-License-Identifier: GPL-3.0-only

# Build this app as an LLVM libfuzzer target (native_sim/native/64 + clang).
CONFIG_ARCH_POSIX_LIBFUZZER=y
CONFIG_ASSERT=y

# The real nRF filesystem port runs over Zephyr NVS on the flash simulator,
# exactly as tests/apdu drives it.
CONFIG_FLASH=y
CONFIG_FLASH_MAP=y
CONFIG_FLASH_SIMULATOR=y
CONFIG_NVS=y

# The UICC core allocates its context, file buffers and directory cache through
# the port heap (SS_ALLOC -> port_malloc -> k_malloc).
CONFIG_HEAP_MEM_POOL_SIZE=65536
```

## boards/native_sim.overlay
```dts
/*
 * SPDX-FileCopyrightText: Copyright (c) 2026 Onomondo ApS
 * SPDX-License-Identifier: GPL-3.0-only
 *
 * lib/ss_fs.c resolves its storage through PARTITION_*(nvs_storage), so the
 * simulated flash needs a partition with that node label. native_sim's flash0
 * is 2 MB but only maps partitions up to 0x100000, so this carves the region
 * above that -- the same 0x8000 the nRF91 targets use, on flash0's 4096-byte
 * erase block that ss_init_fs() hardcodes as its NVS sector size. Copied from
 * tests/apdu/boards/native_sim.overlay.
 */

&flash0 {
	partitions {
		nvs_storage: partition@100000 {
			label = "nvs_storage";
			reg = <0x00100000 0x00008000>;
		};
	};
};
```

## src/main.c
```c
/*
 * SPDX-FileCopyrightText: Copyright (c) 2026 Onomondo ApS
 * SPDX-License-Identifier: GPL-3.0-only
 *
 * Full-transact fuzz target: each case is one C-APDU fed to
 * ss_application_apdu_transact() over the real nRF filesystem port (ss_fs.c /
 * ss_cache.c on Zephyr NVS over the flash simulator), seeded with the same
 * template.bin image the firmware flashes. This drives what the stateless
 * parser target cannot: APDU dispatch, SELECT/READ/UPDATE, path resolution, the
 * DIR cache and (via ENVELOPE) the proactive and SMS-PP paths -- all with the
 * storage layer underneath, exactly as on a device.
 */

#include <stdint.h>
#include <string.h>

#include <zephyr/drivers/flash.h>
#include <zephyr/kernel.h>
#include <zephyr/logging/log.h>
#include <zephyr/storage/flash_map.h>

#include <nrf_softsim.h>
#include <onomondo/softsim/softsim.h>

#include "fuzz_entry.h"

/* ss_fs.c does LOG_MODULE_DECLARE(softsim, ...); register it once here. */
LOG_MODULE_REGISTER(softsim, CONFIG_SOFTSIM_NRF_LOG_LEVEL);

static const uint8_t template_bin[] = {
#include <template_bin.inc>
};

/* Response: max Le (256) plus the status word. */
#define RSP_MAX 260
/* Input cap: header + extended (00 Lc1 Lc2) + a full 256-byte body + Le is
 * enough to reach the extended-length paths and the apdu.cmd[256] boundary. */
#define REQ_MAX 512

static struct ss_context *ctx;

void fuzz_setup(void)
{
	const struct device *flash_dev = PARTITION_DEVICE(nvs_storage);

	/* Seed the partition the way the flashed template.hex would: the raw NVS
	 * image at the partition base, erased flash after it. If this cannot be
	 * done the whole run is meaningless, so assert rather than limp on. */
	__ASSERT(device_is_ready(flash_dev), "flash simulator not ready");
	flash_erase(flash_dev, PARTITION_OFFSET(nvs_storage), PARTITION_SIZE(nvs_storage));
	flash_write(flash_dev, PARTITION_OFFSET(nvs_storage), template_bin, sizeof(template_bin));

	__ASSERT(ss_init_fs() == 0, "ss_init_fs() rejected the template image");

	ctx = ss_new_ctx();
	__ASSERT(ctx != NULL, "could not allocate a UICC context");
}

void fuzz_one(const uint8_t *data, size_t len)
{
	uint8_t req[REQ_MAX];
	uint8_t rsp[RSP_MAX];
	size_t req_len;

	if (len == 0 || len > sizeof(req))
		return;

	/* ss_reset re-selects the MF, giving every case the same selection start.
	 *
	 * ponytail: the flash simulator is process-global and the OS boots once, so
	 * writes (UPDATE BINARY, and any OTA/refresh reached via ENVELOPE) from
	 * earlier cases persist into later ones -- state accumulates. That helps
	 * reach deep states but means a crash found mid-run can need the whole
	 * corpus order to reproduce. Upgrade path if that bites: re-seed the
	 * partition (erase + write template_bin) here per case -- correct but
	 * ~1000x slower, so not the default. */
	ss_reset(ctx);

	/* transact may write into request_buf; hand it a private, sized copy. */
	memcpy(req, data, len);
	req_len = len;

	ss_application_apdu_transact(ctx, rsp, sizeof(rsp), req, &req_len);
}
```
